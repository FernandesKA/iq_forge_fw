/*
 * AD9361 as a universal spidev node on PS SPI0, chip-select 0.
 *
 * This project's PL (zynq_rk7020_ps_wrapper) has no axi_ad9361/DMA
 * fabric cores - it's just a dds_tx_chain_wrapper with no AXI/register
 * interface (see zynq-rk7020f-iqforge.dts in buildroot_custom). So this
 * overlay does NOT bind the mainline adi,ad9361 IIO driver (that one
 * needs cf_ad9361_adc/dac cores for DMA streaming, see the fmcomms2
 * RK-ZYNQ7020-F-AD board's zynq-rk7020f-ad.dts for that setup).
 *
 * Instead it exposes AD9361 as a plain spidev character device
 * (/dev/spidevX.0), so project::iq_forge (hal::spi_device +
 * drivers::ad9361) can do register reads/writes from userspace.
 *
 * compatible = "rohm,dh2228fv": the kernel's spidev driver refuses to
 * bind to a node whose compatible is the literal string "spidev" -
 * that's a deliberate anti-abuse check (spi_match_device() in
 * drivers/spi/spidev.c only matches entries in its own of_device_id
 * table, which does NOT include "spidev" itself). "rohm,dh2228fv" is
 * one of the placeholder compatibles that table does accept, and is
 * the standard convention for a generic spidev passthrough node -
 * confirmed on this exact board: compatible = "spidev" left spi0.0
 * permanently unbound (no /dev/spidev*, driver_match_device() == false).
 *
 * spi-cpha matches the RK-ZYNQ7020-F-AD board's working ad9361-phy
 * node - same carrier, same PS SPI0 EMIO -> AD9361 header wiring,
 * different PL/DMA-only.
 *
 * Requires the target's base devicetree (zynq-rk7020f-iqforge.dtb) to
 * carry &spi0 with status = "okay" - already the case, see
 * buildroot_custom board/zynq/RK-ZYNQ7020-F-IQFORGE/dts. This overlay
 * also sets status = "okay" on &spi0 itself, defensively.
 *
 * Also requires the KERNEL to have the PS7 SPI controller driver
 * built in: &spi0/&spi1 are compatible = "xlnx,zynq-spi-r1p6"
 * (zynq-7000.dtsi), matched by drivers/spi/spi-cadence.c /
 * CONFIG_SPI_CADENCE - NOT CONFIG_SPI_XILINX (that one's for the AXI
 * Quad SPI *PL fabric* IP core, a different piece of hardware we don't
 * have). Without CONFIG_SPI_CADENCE there's no spi_master bound to
 * spi0 at all, so this overlay's ad9361@0 child node can apply cleanly
 * (device tree merge succeeds) and STILL never produce a
 * /dev/spidevX.0 - confirmed on hardware: RK-ZYNQ7020-F-IQFORGE's
 * linux-config.fragment only had CONFIG_SPI_SPIDEV (the spidev *child*
 * driver) missing CONFIG_SPI_CADENCE (the *controller* driver) - see
 * buildroot_custom board/zynq/RK-ZYNQ7020-F-IQFORGE/linux-config.fragment.
 */

/dts-v1/;
/plugin/;

&spi0 {
	status = "okay";
	#address-cells = <1>;
	#size-cells = <0>;

	ad9361: ad9361@0 {
		compatible = "rohm,dh2228fv";
		status = "okay";
		reg = <0>;
		spi-cpha;
		spi-max-frequency = <10000000>;
	};
};

/*
 * XVC-over-UIO: debug_bridge PL core added to zynq_rk7020_ps_wrapper for
 * JTAG-over-Ethernet access (xvc-server + xvc-uio, generic_uio path - see
 * buildroot_external/package/xvc-uio/Config.in). Targets "/" (like
 * zynq-dtgen's own fragment@0/target-path="/" PL overlay convention, see
 * package/zynq-dtgen/gen-dts.sh) since this board's base dts has no PL
 * simple-bus node of its own to attach under.
 */
&{/} {
	debug_bridge_0: debug_bridge@43c00000 {
		clock-names = "s_axi_aclk";
		clocks = <&clkc 15>;
		compatible = "xlnx,debug-bridge-3.0", "generic-uio";
		reg = <0x43c00000 0x10000>;
		xlnx,bscan-mux = <0x1>;
		xlnx,build-revision = <0x0>;
		xlnx,chip-id = <0x0>;
		xlnx,clk-input-freq-hz = <0x11e1a300>;
		xlnx,core-major-ver = <0x1>;
		xlnx,core-minor-alpha-ver = <0x61>;
		xlnx,core-minor-ver = <0x0>;
		xlnx,core-type = <0x1>;
		xlnx,dclk-has-reset = <0x0>;
		xlnx,debug-mode = <0x2>;
		xlnx,design-type = <0x0>;
		xlnx,device-family = <0x0>;
		xlnx,en-bscanid-vec = "false";
		xlnx,en-int-sim = <0x1>;
		xlnx,en-passthrough = <0x0>;
		xlnx,enable-clk-divider = "false";
		xlnx,fifo-style = "SUBCORE";
		xlnx,ir-id-instr = <0x0>;
		xlnx,ir-user1-instr = <0x0>;
		xlnx,ir-width = <0x0>;
		xlnx,major-version = <0xe>;
		xlnx,master-intf-type = <0x1>;
		xlnx,minor-version = <0x1>;
		xlnx,num-bs-master = <0x0>;
		xlnx,pcie-ext-cfg-base-addr = <0x400>;
		xlnx,pcie-ext-cfg-next-ptr = <0x000>;
		xlnx,pcie-ext-cfg-vsec-id = <0x0008>;
		xlnx,pcie-ext-cfg-vsec-length = <0x020>;
		xlnx,pcie-ext-cfg-vsec-rev-id = <0x0>;
		xlnx,tck-clock-ratio = <0x8>;
		xlnx,two-prim-mode = "false";
		xlnx,use-bufr = <0x0>;
		xlnx,use-ext-bscan = "true";
		xlnx,use-softbscan = <0x1>;
		xlnx,use-startup-clk = "false";
		xlnx,user-scan-chain = <0x1>;
		xlnx,xsdb-num-slaves = <0x0>;
		xlnx,xvc-hw-id = <0x0001>;
		xlnx,xvc-sw-id = <0x0001>;
	};
};
